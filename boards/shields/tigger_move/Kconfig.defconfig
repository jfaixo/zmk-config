## boards/shields/tigger_move/Kconfig.defconfig
```kconfig
if SHIELD_TIGGER_MOVE_LEFT

config ZMK_KEYBOARD_NAME
    default "Tigger Move"

config ZMK_SPLIT_ROLE_CENTRAL
    default y

endif

if SHIELD_TIGGER_MOVE_LEFT || SHIELD_TIGGER_MOVE_RIGHT

config ZMK_SPLIT
    default y

endif
```

## boards/shields/tigger_move/Kconfig.shield
```kconfig
config SHIELD_TIGGER_MOVE_LEFT
    def_bool $(shields_list_contains,tigger_move_left)

config SHIELD_TIGGER_MOVE_RIGHT
    def_bool $(shields_list_contains,tigger_move_right)
```

## boards/shields/tigger_nice_view/Kconfig.shield
```kconfig
# Copyright (c) 2022 The ZMK Contributors
# SPDX-License-Identifier: MIT

config SHIELD_TIGGER_NICE_VIEW
    def_bool $(shields_list_contains,tigger_nice_view)
```
