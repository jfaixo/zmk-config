## boards/shields/palette/Kconfig.defconfig
```kconfig
if SHIELD_PALETTE_LEFT

config ZMK_KEYBOARD_NAME
    default "Palette"

config ZMK_SPLIT_ROLE_CENTRAL
    default y

endif

if SHIELD_PALETTE_LEFT || SHIELD_PALETTE_RIGHT

config ZMK_SPLIT
    default y

endif
```

## boards/shields/palette/Kconfig.shield
```kconfig
config SHIELD_PALETTE_DONGLE
    def_bool $(shields_list_contains,palette_dongle)

config SHIELD_PALETTE_LEFT
    def_bool $(shields_list_contains,palette_left)

config SHIELD_PALETTE_RIGHT
    def_bool $(shields_list_contains,palette_right)
```

## config/west.yml
```yaml
manifest:
  remotes:
    - name: zmkfirmware
      url-base: https://github.com/zmkfirmware
    - name: me
      url-base: https://github.com/jfaixo
  projects:
    - name: zmk
      remote: zmkfirmware
      revision: main
      import: app/west.yml
  self:
    path: config
```
